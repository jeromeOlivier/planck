## config/west.yml
```yaml
manifest:
  remotes:
    - name: petejohanson
      url-base: https://github.com/petejohanson/
  projects:
    - name: zmk
      remote: petejohanson
      revision: zephyr/3.3-update
      import: app/west.yml
  self:
    path: config
```
